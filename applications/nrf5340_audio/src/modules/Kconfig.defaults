## applications/nrf5340_audio/src/modules/Kconfig.defaults
```kconfig
#
# Copyright (c) 2022 Nordic Semiconductor ASA
#
# SPDX-License-Identifier: LicenseRef-Nordic-5-Clause
#

# GATEWAY
if AUDIO_DEV = 2

if AUDIO_SOURCE_USB

config USB_DEVICE_STACK_NEXT
	default y

config USBD_AUDIO2_CLASS
	default y

# Net buf options needed for USB stack
config NET_BUF
	default y

config USB_DEVICE_AUDIO
	default y

config SAMPLE_USBD_MANUFACTURER
	string "USB device sample manufacturer string"
	default "Nordic Semiconductor"
	help
	  USB device sample manufacturer string.

config SAMPLE_USBD_PRODUCT
	string "USB device sample product string"
	default "nRF5340 Audio"
	help
	  USB device sample product stringa.

config SAMPLE_USBD_PID
	hex "USB device sample Product ID"
	default 0x0001
	help
	  USB device sample Product ID.

endif # AUDIO_SOURCE_USB

endif # AUDIO_DEV = 2 (GATEWAY)
```
