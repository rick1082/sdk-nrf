## prj.conf
```kconfig
#
# Copyright (c) 2024 Nordic Semiconductor ASA
#
# SPDX-License-Identifier: LicenseRef-Nordic-5-Clause
#

# General
CONFIG_REBOOT=y
CONFIG_DEBUG=y
CONFIG_DEBUG_INFO=y
CONFIG_ASSERT=y
CONFIG_STACK_USAGE=y
CONFIG_THREAD_RUNTIME_STATS=y
CONFIG_MAIN_THREAD_PRIORITY=10
CONFIG_STACK_SENTINEL=y
CONFIG_INIT_STACKS=y
CONFIG_MAIN_STACK_SIZE=12000
CONFIG_THREAD_NAME=y
CONFIG_SYSTEM_WORKQUEUE_STACK_SIZE=1200

# Uart driver
CONFIG_SERIAL=y

# Logging
CONFIG_LOG=y
CONFIG_NEWLIB_LIBC_FLOAT_PRINTF=y
CONFIG_LOG_TAG_MAX_LEN=2
CONFIG_LOG_TAG_DEFAULT="--"

CONFIG_LOG_BUFFER_SIZE=4096
CONFIG_USE_SEGGER_RTT=n
CONFIG_LOG_BACKEND_RTT=n

CONFIG_SOC_NRF53_CPUNET_ENABLE=y

CONFIG_ZBUS=y
CONFIG_ZBUS_RUNTIME_OBSERVERS=y
CONFIG_ZBUS_MSG_SUBSCRIBER=y
CONFIG_ZBUS_MSG_SUBSCRIBER_NET_BUF_POOL_SIZE=20

CONFIG_REGULATOR=y
CONFIG_CONTIN_ARRAY=y
CONFIG_DATA_FIFO=y

# Enable NRFX_CLOCK for ACLK control
CONFIG_NRFX_CLOCK=y
CONFIG_NEWLIB_LIBC=y

# Audio codec LC3 related defines
# FPU_SHARING enables preservation of the hardware floating point registers
# across context switches to allow multiple threads to perform concurrent
# floating point operations.
CONFIG_FPU=y
CONFIG_FPU_SHARING=y

# Enable SDHC interface
CONFIG_DISK_DRIVERS=y
CONFIG_DISK_DRIVER_SDMMC=y

# Allocate buffer on RAM for transferring chunck of data
# from Flash to SPI
CONFIG_SPI_NRFX_RAM_BUFFER_SIZE=128

# CONFIG_the file system
CONFIG_FILE_SYSTEM=y
CONFIG_FAT_FILESYSTEM_ELM=y
CONFIG_FS_FATFS_LFN=y
CONFIG_FS_FATFS_LFN_MODE_STACK=y

# exFAT enabled to support longer file names and higher transfer speed
CONFIG_FS_FATFS_EXFAT=y
CONFIG_FS_FATFS_MAX_LFN=255

# Enable SPI interface
CONFIG_SPI=y

# Enable ADC for board version readback
CONFIG_ADC=y
CONFIG_WATCHDOG=y
CONFIG_TASK_WDT=y

# Use this for debugging thread usage
#CONFIG_LOG_THREAD_ID_PREFIX=y

# Console related defines
CONFIG_CONSOLE=y
CONFIG_UART_CONSOLE=y

# Shell related defines
CONFIG_SHELL=y
CONFIG_KERNEL_SHELL=y
CONFIG_SHELL_BACKEND_SERIAL=y
CONFIG_SHELL_VT100_COMMANDS=y
CONFIG_SHELL_VT100_COLORS=y
CONFIG_SHELL_STACK_SIZE=8096
CONFIG_SHELL_CMD_BUFF_SIZE=128
CONFIG_SHELL_DEFAULT_TERMINAL_WIDTH=120

## Reduce shell memory usage
CONFIG_SHELL_WILDCARD=n
CONFIG_SHELL_HELP_ON_WRONG_ARGUMENT_COUNT=n
CONFIG_SHELL_STATS=n
CONFIG_SHELL_CMDS=n
CONFIG_SHELL_HISTORY=y

# Turn off default shell commands
CONFIG_I2C_SHELL=n
CONFIG_HWINFO_SHELL=n
CONFIG_CLOCK_CONTROL_NRF_SHELL=n
CONFIG_FLASH_SHELL=n
CONFIG_DEVICE_SHELL=n

# Suppress LOG_ERR messages from sd_check_card_type. Because SPI_SDHC has no card presence method,
# assume card is in slot. Thus error message is always shown if card is not inserted
CONFIG_SD_LOG_LEVEL_OFF=y

# Suppress LOG_INF messages from hci_core
CONFIG_BT_HCI_CORE_LOG_LEVEL_WRN=y

## ISO related configs ##
CONFIG_BT=y
CONFIG_BT_DEVICE_NAME_DYNAMIC=y
CONFIG_BT_CAP_INITIATOR=y

CONFIG_BT_ISO_BROADCASTER=y
CONFIG_BT_ISO_MAX_BIG=2
CONFIG_BT_ISO_MAX_CHAN=8
# Should be twice that of BT_ISO_MAX_CHAN
CONFIG_BT_ISO_TX_BUF_COUNT=16

CONFIG_BT_BAP_BROADCAST_SOURCE=y
CONFIG_BT_BAP_BROADCAST_SRC_COUNT=2
CONFIG_BT_EXT_ADV_MAX_ADV_SET=2
CONFIG_BT_BAP_BROADCAST_SRC_SUBGROUP_COUNT=4
CONFIG_BT_BAP_BROADCAST_SRC_STREAM_COUNT=8

# Broadcasting Device - 0x0885
CONFIG_BT_DEVICE_APPEARANCE=2181

CONFIG_TRANSPORT_BIS=y
CONFIG_BT_AUDIO_BROADCAST_CONFIGURABLE=y
CONFIG_BT_AUDIO_BROADCAST_ZBUS_EVT_STREAM_SENT=y

CONFIG_LE_AUDIO_MSG_SUB_THREAD_PRIO=3

CONFIG_SW_CODEC_NONE=y

CONFIG_NRF5340_AUDIO_SD_CARD_MODULE=y
CONFIG_NRF5340_AUDIO_SD_CARD_LC3_FILE=y
CONFIG_NRF5340_AUDIO_SD_CARD_LC3_STREAMER=y

CONFIG_SD_CARD_LC3_STREAMER_STACK_SIZE=8000
CONFIG_MODULE_SD_CARD_LOG_LEVEL_WRN=y

CONFIG_FS_FATFS_NUM_DIRS=4
CONFIG_FS_FATFS_NUM_FILES=4

CONFIG_SD_CARD_LC3_STREAMER_MAX_FRAME_SIZE=100

CONFIG_MODULE_SD_CARD_LC3_STREAMER_LOG_LEVEL_DBG=y
CONFIG_SPEED_OPTIMIZATIONS=y
CONFIG_SD_CARD_LC3_STREAMER_THREAD_PRIO=1
CONFIG_SPIN_VALIDATE=n
```

## include/presets.h
```c
/*
 * Copyright (c) 2024 Nordic Semiconductor ASA
 *
 * SPDX-License-Identifier: LicenseRef-Nordic-5-Clause
 */

#ifndef _PRESETS_H_
#define _PRESETS_H_

/**
 * @defgroup auraconfig_presets nRF Auraconfig presets
 * @brief nRF Auraconfig presets
 *
 * @{
 */

#include <zephyr/bluetooth/audio/audio.h>
#include <zephyr/bluetooth/audio/bap_lc3_preset.h>

#define PRESET_NAME_MAX 8
#define LANGUAGE_LEN	3

/* Low latency settings */
static struct bt_bap_lc3_preset lc3_preset_8_1_1 =
	BT_BAP_LC3_BROADCAST_PRESET_8_1_1(BT_AUDIO_LOCATION_MONO_AUDIO, BT_AUDIO_CONTEXT_TYPE_ANY);
static struct bt_bap_lc3_preset lc3_preset_8_2_1 =
	BT_BAP_LC3_BROADCAST_PRESET_8_2_1(BT_AUDIO_LOCATION_MONO_AUDIO, BT_AUDIO_CONTEXT_TYPE_ANY);
static struct bt_bap_lc3_preset lc3_preset_16_1_1 =
	BT_BAP_LC3_BROADCAST_PRESET_16_1_1(BT_AUDIO_LOCATION_MONO_AUDIO, BT_AUDIO_CONTEXT_TYPE_ANY);
static struct bt_bap_lc3_preset lc3_preset_16_2_1 =
	BT_BAP_LC3_BROADCAST_PRESET_16_2_1(BT_AUDIO_LOCATION_MONO_AUDIO, BT_AUDIO_CONTEXT_TYPE_ANY);
static struct bt_bap_lc3_preset lc3_preset_24_1_1 =
	BT_BAP_LC3_BROADCAST_PRESET_24_1_1(BT_AUDIO_LOCATION_MONO_AUDIO, BT_AUDIO_CONTEXT_TYPE_ANY);
static struct bt_bap_lc3_preset lc3_preset_24_2_1 =
	BT_BAP_LC3_BROADCAST_PRESET_24_2_1(BT_AUDIO_LOCATION_MONO_AUDIO, BT_AUDIO_CONTEXT_TYPE_ANY);
static struct bt_bap_lc3_preset lc3_preset_32_1_1 =
	BT_BAP_LC3_BROADCAST_PRESET_32_1_1(BT_AUDIO_LOCATION_MONO_AUDIO, BT_AUDIO_CONTEXT_TYPE_ANY);
static struct bt_bap_lc3_preset lc3_preset_32_2_1 =
	BT_BAP_LC3_BROADCAST_PRESET_32_2_1(BT_AUDIO_LOCATION_MONO_AUDIO, BT_AUDIO_CONTEXT_TYPE_ANY);
static struct bt_bap_lc3_preset lc3_preset_48_1_1 =
	BT_BAP_LC3_BROADCAST_PRESET_48_1_1(BT_AUDIO_LOCATION_MONO_AUDIO, BT_AUDIO_CONTEXT_TYPE_ANY);
static struct bt_bap_lc3_preset lc3_preset_48_2_1 =
	BT_BAP_LC3_BROADCAST_PRESET_48_2_1(BT_AUDIO_LOCATION_MONO_AUDIO, BT_AUDIO_CONTEXT_TYPE_ANY);
static struct bt_bap_lc3_preset lc3_preset_48_3_1 =
	BT_BAP_LC3_BROADCAST_PRESET_48_3_1(BT_AUDIO_LOCATION_MONO_AUDIO, BT_AUDIO_CONTEXT_TYPE_ANY);
static struct bt_bap_lc3_preset lc3_preset_48_4_1 =
	BT_BAP_LC3_BROADCAST_PRESET_48_4_1(BT_AUDIO_LOCATION_MONO_AUDIO, BT_AUDIO_CONTEXT_TYPE_ANY);
static struct bt_bap_lc3_preset lc3_preset_48_5_1 =
	BT_BAP_LC3_BROADCAST_PRESET_48_5_1(BT_AUDIO_LOCATION_MONO_AUDIO, BT_AUDIO_CONTEXT_TYPE_ANY);
static struct bt_bap_lc3_preset lc3_preset_48_6_1 =
	BT_BAP_LC3_BROADCAST_PRESET_48_6_1(BT_AUDIO_LOCATION_MONO_AUDIO, BT_AUDIO_CONTEXT_TYPE_ANY);
/* High reliability settings */
static struct bt_bap_lc3_preset lc3_preset_8_1_2 =
	BT_BAP_LC3_BROADCAST_PRESET_8_1_2(BT_AUDIO_LOCATION_MONO_AUDIO, BT_AUDIO_CONTEXT_TYPE_ANY);
static struct bt_bap_lc3_preset lc3_preset_8_2_2 =
	BT_BAP_LC3_BROADCAST_PRESET_8_2_2(BT_AUDIO_LOCATION_MONO_AUDIO, BT_AUDIO_CONTEXT_TYPE_ANY);
static struct bt_bap_lc3_preset lc3_preset_16_1_2 =
	BT_BAP_LC3_BROADCAST_PRESET_16_1_2(BT_AUDIO_LOCATION_MONO_AUDIO, BT_AUDIO_CONTEXT_TYPE_ANY);
static struct bt_bap_lc3_preset lc3_preset_16_2_2 =
	BT_BAP_LC3_BROADCAST_PRESET_16_2_2(BT_AUDIO_LOCATION_MONO_AUDIO, BT_AUDIO_CONTEXT_TYPE_ANY);
static struct bt_bap_lc3_preset lc3_preset_24_1_2 =
	BT_BAP_LC3_BROADCAST_PRESET_24_1_2(BT_AUDIO_LOCATION_MONO_AUDIO, BT_AUDIO_CONTEXT_TYPE_ANY);
static struct bt_bap_lc3_preset lc3_preset_24_2_2 =
	BT_BAP_LC3_BROADCAST_PRESET_24_2_2(BT_AUDIO_LOCATION_MONO_AUDIO, BT_AUDIO_CONTEXT_TYPE_ANY);
static struct bt_bap_lc3_preset lc3_preset_32_1_2 =
	BT_BAP_LC3_BROADCAST_PRESET_32_1_2(BT_AUDIO_LOCATION_MONO_AUDIO, BT_AUDIO_CONTEXT_TYPE_ANY);
static struct bt_bap_lc3_preset lc3_preset_32_2_2 =
	BT_BAP_LC3_BROADCAST_PRESET_32_2_2(BT_AUDIO_LOCATION_MONO_AUDIO, BT_AUDIO_CONTEXT_TYPE_ANY);
static struct bt_bap_lc3_preset lc3_preset_48_1_2 =
	BT_BAP_LC3_BROADCAST_PRESET_48_1_2(BT_AUDIO_LOCATION_MONO_AUDIO, BT_AUDIO_CONTEXT_TYPE_ANY);
static struct bt_bap_lc3_preset lc3_preset_48_2_2 =
	BT_BAP_LC3_BROADCAST_PRESET_48_2_2(BT_AUDIO_LOCATION_MONO_AUDIO, BT_AUDIO_CONTEXT_TYPE_ANY);
static struct bt_bap_lc3_preset lc3_preset_48_3_2 =
	BT_BAP_LC3_BROADCAST_PRESET_48_3_2(BT_AUDIO_LOCATION_MONO_AUDIO, BT_AUDIO_CONTEXT_TYPE_ANY);
static struct bt_bap_lc3_preset lc3_preset_48_4_2 =
	BT_BAP_LC3_BROADCAST_PRESET_48_4_2(BT_AUDIO_LOCATION_MONO_AUDIO, BT_AUDIO_CONTEXT_TYPE_ANY);
static struct bt_bap_lc3_preset lc3_preset_48_5_2 =
	BT_BAP_LC3_BROADCAST_PRESET_48_5_2(BT_AUDIO_LOCATION_MONO_AUDIO, BT_AUDIO_CONTEXT_TYPE_ANY);
static struct bt_bap_lc3_preset lc3_preset_48_6_2 =
	BT_BAP_LC3_BROADCAST_PRESET_48_6_2(BT_AUDIO_LOCATION_MONO_AUDIO, BT_AUDIO_CONTEXT_TYPE_ANY);

/** @brief Preset information */
struct bap_preset {
	struct bt_bap_lc3_preset *preset;
	char name[PRESET_NAME_MAX];
};

/**
 * @brief Presets translation struct
 *
 * @note Translation between preset names and preset structures.
 */
static struct bap_preset bap_presets[] = {
	{.preset = &lc3_preset_8_1_1, .name = "8_1_1"},
	{.preset = &lc3_preset_8_2_1, .name = "8_2_1"},
	{.preset = &lc3_preset_16_1_1, .name = "16_1_1"},
	{.preset = &lc3_preset_16_2_1, .name = "16_2_1"},
	{.preset = &lc3_preset_24_1_1, .name = "24_1_1"},
	{.preset = &lc3_preset_24_2_1, .name = "24_2_1"},
	{.preset = &lc3_preset_32_1_1, .name = "32_1_1"},
	{.preset = &lc3_preset_32_2_1, .name = "32_2_1"},
	{.preset = &lc3_preset_48_1_1, .name = "48_1_1"},
	{.preset = &lc3_preset_48_2_1, .name = "48_2_1"},
	{.preset = &lc3_preset_48_3_1, .name = "48_3_1"},
	{.preset = &lc3_preset_48_4_1, .name = "48_4_1"},
	{.preset = &lc3_preset_48_5_1, .name = "48_5_1"},
	{.preset = &lc3_preset_48_6_1, .name = "48_6_1"},
	{.preset = &lc3_preset_8_1_2, .name = "8_1_2"},
	{.preset = &lc3_preset_8_2_2, .name = "8_2_2"},
	{.preset = &lc3_preset_16_1_2, .name = "16_1_2"},
	{.preset = &lc3_preset_16_2_2, .name = "16_2_2"},
	{.preset = &lc3_preset_24_1_2, .name = "24_1_2"},
	{.preset = &lc3_preset_24_2_2, .name = "24_2_2"},
	{.preset = &lc3_preset_32_1_2, .name = "32_1_2"},
	{.preset = &lc3_preset_32_2_2, .name = "32_2_2"},
	{.preset = &lc3_preset_48_1_2, .name = "48_1_2"},
	{.preset = &lc3_preset_48_2_2, .name = "48_2_2"},
	{.preset = &lc3_preset_48_3_2, .name = "48_3_2"},
	{.preset = &lc3_preset_48_4_2, .name = "48_4_2"},
	{.preset = &lc3_preset_48_5_2, .name = "48_5_2"},
	{.preset = &lc3_preset_48_6_2, .name = "48_6_2"},
};

#define LOCATION_NAME_LEN_MAX 4

/** @brief Audio locations */
struct audio_location {
	enum bt_audio_location location;
	char name[LOCATION_NAME_LEN_MAX + 1];
};

/**
 * @brief	Audio location translation struct
 *
 * @note	If there is any change to the specification of audio
 *		locations then this structure must be checked for conformance.
 */
static struct audio_location locations[] = {
	{.location = BT_AUDIO_LOCATION_MONO_AUDIO, .name = "MA"},
	{.location = BT_AUDIO_LOCATION_FRONT_LEFT, .name = "FL"},
	{.location = BT_AUDIO_LOCATION_FRONT_RIGHT, .name = "FR"},
	{.location = BT_AUDIO_LOCATION_FRONT_CENTER, .name = "FC"},
	{.location = BT_AUDIO_LOCATION_LOW_FREQ_EFFECTS_1, .name = "LFE1"},
	{.location = BT_AUDIO_LOCATION_BACK_LEFT, .name = "BL"},
	{.location = BT_AUDIO_LOCATION_BACK_RIGHT, .name = "BR"},
	{.location = BT_AUDIO_LOCATION_FRONT_LEFT_OF_CENTER, .name = "FLC"},
	{.location = BT_AUDIO_LOCATION_FRONT_RIGHT_OF_CENTER, .name = "FRC"},
	{.location = BT_AUDIO_LOCATION_BACK_CENTER, .name = "BC"},
	{.location = BT_AUDIO_LOCATION_LOW_FREQ_EFFECTS_2, .name = "LFE2"},
	{.location = BT_AUDIO_LOCATION_SIDE_LEFT, .name = "SL"},
	{.location = BT_AUDIO_LOCATION_SIDE_RIGHT, .name = "SR"},
	{.location = BT_AUDIO_LOCATION_TOP_FRONT_LEFT, .name = "TFL"},
	{.location = BT_AUDIO_LOCATION_TOP_FRONT_RIGHT, .name = "TFR"},
	{.location = BT_AUDIO_LOCATION_TOP_FRONT_CENTER, .name = "TFC"},
	{.location = BT_AUDIO_LOCATION_TOP_CENTER, .name = "TC"},
	{.location = BT_AUDIO_LOCATION_TOP_BACK_LEFT, .name = "TBL"},
	{.location = BT_AUDIO_LOCATION_TOP_BACK_RIGHT, .name = "TBR"},
	{.location = BT_AUDIO_LOCATION_TOP_SIDE_LEFT, .name = "TSL"},
	{.location = BT_AUDIO_LOCATION_TOP_SIDE_RIGHT, .name = "TSR"},
	{.location = BT_AUDIO_LOCATION_TOP_BACK_CENTER, .name = "TBC"},
	{.location = BT_AUDIO_LOCATION_BOTTOM_FRONT_CENTER, .name = "BFC"},
	{.location = BT_AUDIO_LOCATION_BOTTOM_FRONT_LEFT, .name = "BFL"},
	{.location = BT_AUDIO_LOCATION_BOTTOM_FRONT_RIGHT, .name = "BFR"},
	{.location = BT_AUDIO_LOCATION_FRONT_LEFT_WIDE, .name = "FLW"},
	{.location = BT_AUDIO_LOCATION_FRONT_RIGHT_WIDE, .name = "FRW"},
	{.location = BT_AUDIO_LOCATION_LEFT_SURROUND, .name = "LS"},
	{.location = BT_AUDIO_LOCATION_RIGHT_SURROUND, .name = "RS"},
};

/** @brief Use case types */
enum usecase_type {
	LECTURE,
	SILENT_TV_1,
	SILENT_TV_2,
	MULTI_LANGUAGE,
	PERSONAL_SHARING,
	PERSONAL_MULTI_LANGUAGE,
	FOUR_BISES_DEMO,
};

/** @brief Use case information */
struct usecase_info {
	/* Use case type */
	enum usecase_type use_case;
	/* Use case name */
	char name[40];
};

/** @brief Pre-defined use cases */
static struct usecase_info pre_defined_use_cases[] = {
	{.use_case = LECTURE, .name = "Lecture"},
	{.use_case = SILENT_TV_1, .name = "Silent TV 1"},
	{.use_case = SILENT_TV_2, .name = "Silent TV 2"},
	{.use_case = MULTI_LANGUAGE, .name = "Multi-language"},
	{.use_case = PERSONAL_SHARING, .name = "Personal sharing"},
	{.use_case = PERSONAL_MULTI_LANGUAGE, .name = "Personal multi-language"},
	{.use_case = FOUR_BISES_DEMO, .name = "4 BISes demo"},
};

/** @} */

#endif /* _PRESETS_H_ */
```
