## CMakeLists.txt
```
# SPDX-License-Identifier: Apache-2.0

cmake_minimum_required(VERSION 3.20.0)

find_package(Zephyr REQUIRED HINTS $ENV{ZEPHYR_BASE})
project(mic_pointer_nrf54l15)

target_sources(app PRIVATE
  src/main.c
  src/le_audio_mic.c
)
```

## sample.yaml
```
sample:
  description: nrf54l15 as air mouse with LE audio mic
    application
  name: mic_pointer_nrf54l15
common:
  min_ram: 2
  min_flash: 16
  tags: introduction
  integration_platforms:
    - native_sim
  harness: console
  harness_config:
    type: one_line
    regex:
      - "Hello World! (.*)"
tests:
  sample.basic.helloworld:
    tags: introduction
```

## prj.conf
```kconfig
CONFIG_I2C=y
CONFIG_SENSOR=y

# LSM6DS3TR-C (driven by the st,lsm6dsl driver) on the XIAO nRF54L15 Sense.
# ODR/FS default to 0 ("selected at runtime"), which leaves the chip powered
# down, so pin them here: 104 Hz, +/-2g, +/-250 dps.
CONFIG_LSM6DSL_ACCEL_ODR=4
CONFIG_LSM6DSL_ACCEL_FS=2
CONFIG_LSM6DSL_GYRO_ODR=4
CONFIG_LSM6DSL_GYRO_FS=250
CONFIG_LSM6DSL_ENABLE_TEMP=y

# %f in printf() on picolibc
CONFIG_PICOLIBC_IO_FLOAT=y

# USR button -> left mouse button
CONFIG_INPUT=y

# Hardware FPU for the gyro integration
CONFIG_FPU=y
CONFIG_FPU_SHARING=y

# The Bluetooth stack overruns the default stacks here; without stack
# protection that silently corrupts the net_buf pools instead of faulting.
CONFIG_HW_STACK_PROTECTION=y
CONFIG_SYSTEM_WORKQUEUE_STACK_SIZE=2048
CONFIG_BT_TX_PROCESSOR_STACK_SIZE=1024

# Bluetooth HID over GATT
CONFIG_BT=y
CONFIG_BT_PERIPHERAL=y
CONFIG_BT_DEVICE_NAME="XIAO Air Mouse"
# 962 = HID Mouse
CONFIG_BT_DEVICE_APPEARANCE=962
CONFIG_BT_MAX_CONN=1
CONFIG_BT_MAX_PAIRED=2

CONFIG_BT_HIDS=y
CONFIG_BT_HIDS_INPUT_REP_MAX=1
CONFIG_BT_HIDS_OUTPUT_REP_MAX=0
CONFIG_BT_HIDS_FEATURE_REP_MAX=0
CONFIG_BT_HIDS_ATTR_MAX=20
CONFIG_BT_HIDS_MAX_CLIENT_COUNT=1
CONFIG_BT_HIDS_DEFAULT_PERM_RW_ENCRYPT=y
CONFIG_BT_CONN_CTX=y

# HIDS registers 6 characteristics and 8 16-bit UUIDs; the NCS GATT pool
# defaults (5 and 10) are too small and bt_hids_init() would fail with -ENOMEM.
CONFIG_BT_GATT_CHRC_POOL_SIZE=10
CONFIG_BT_GATT_UUID16_POOL_SIZE=20

# Device Information Service - hosts use the PnP IDs to pick a HID driver
CONFIG_BT_DIS=y
CONFIG_BT_DIS_MANUF_NAME=y
CONFIG_BT_DIS_MANUF_NAME_STR="Seeed Studio"
CONFIG_BT_DIS_PNP=y
CONFIG_BT_DIS_PNP_VID_SRC=2
CONFIG_BT_DIS_PNP_VID=0x1915
CONFIG_BT_DIS_PNP_PID=0xEEEE
CONFIG_BT_DIS_PNP_VER=0x0100

# Just-works pairing (the device has no display or keypad) plus bond storage
CONFIG_BT_SMP=y
CONFIG_BT_SETTINGS=y
CONFIG_SETTINGS=y
CONFIG_FLASH=y
CONFIG_FLASH_MAP=y
CONFIG_ZMS=y

# Ask the host for a short connection interval so cursor motion stays smooth
CONFIG_BT_PERIPHERAL_PREF_MIN_INT=6
CONFIG_BT_PERIPHERAL_PREF_MAX_INT=12
CONFIG_BT_PERIPHERAL_PREF_LATENCY=0
CONFIG_BT_PERIPHERAL_PREF_TIMEOUT=400

CONFIG_MAIN_STACK_SIZE=3584

# --------------------------------------------------------------------------
# LE Audio: PDM microphone as a BAP unicast server source
# (ported from samples/bluetooth/bap_unicast_server_nrf54l15)
# --------------------------------------------------------------------------
CONFIG_AUDIO=y
CONFIG_AUDIO_DMIC=y
CONFIG_CLOCK_CONTROL=y

# BT_AUDIO depends on UTF8
CONFIG_UTF8=y
CONFIG_BT_AUDIO=y
CONFIG_BT_BAP_UNICAST_SERVER=y
CONFIG_BT_ASCS=y
# Source only: the board has a microphone and no speaker. With no sink ASE and
# no Sink PAC, a host enumerates a capture endpoint and no render endpoint.
CONFIG_BT_ASCS_MAX_ASE_SNK_COUNT=0
CONFIG_BT_ASCS_MAX_ASE_SRC_COUNT=1
CONFIG_BT_PAC_SNK=n
CONFIG_BT_ISO_PERIPHERAL=y
CONFIG_BT_ISO_TX_BUF_COUNT=16
CONFIG_BT_ISO_MAX_CHAN=1
CONFIG_BT_AUDIO_CODEC_CFG_MAX_METADATA_SIZE=80

# Microphone Control Service, so the client can mute/unmute the microphone.
# No AICS instances - gain is fixed at build time.
CONFIG_BT_MICP_MIC_DEV=y
CONFIG_BT_MICP_MIC_DEV_AICS_INSTANCE_COUNT=0
# Mandatory to support at least 1 for ASCS
CONFIG_BT_ATT_PREPARE_COUNT=8
CONFIG_BT_GATT_DYNAMIC_DB=y
CONFIG_BT_BONDABLE=y

# The client picks QoS; do not fight it with our own parameter updates.
CONFIG_BT_GAP_AUTO_UPDATE_CONN_PARAMS=n

# T2 software LC3 encoder (needs the hard-float ABI, hence CONFIG_FPU above)
CONFIG_SW_CODEC_LC3_T2_SOFTWARE=y
CONFIG_LC3_ENC_CHAN_MAX=1

# The LC3 encoder is stack hungry and BT audio does work in the system workqueue
CONFIG_SYSTEM_WORKQUEUE_STACK_SIZE=8192
CONFIG_BT_BUF_EVT_RX_SIZE=255
CONFIG_BT_BUF_ACL_RX_SIZE=255
CONFIG_BT_BUF_ACL_TX_SIZE=251
CONFIG_BT_BUF_CMD_TX_SIZE=255

CONFIG_LOG=y
CONFIG_LOG_BUFFER_SIZE=4096
CONFIG_THREAD_NAME=y

# Deferred logging keeps UART writes out of the BT/ISO callbacks. The default
# 768 byte processing-thread stack is not enough for the wider messages here -
# it overflows, the thread is aborted, and all logging (including the fault
# report) goes silent.
CONFIG_LOG_PROCESS_THREAD_STACK_SIZE=2048
```

## src/main.c
```c
/*
 * Copyright (c) 2012-2014 Wind River Systems, Inc.
 *
 * SPDX-License-Identifier: Apache-2.0
 */

/*
 * Air mouse with an LE Audio microphone for the Seeed XIAO nRF54L15 Sense.
 *
 * The on-board LSM6DS3TR-C gyroscope is sampled at 100 Hz; yaw and pitch rates
 * are integrated into relative cursor deltas and pushed to the host as HID over
 * GATT (HOGP) mouse reports. The USR button is the left mouse button.
 *
 * The same connection also carries a BAP unicast server that streams the
 * on-board PDM microphone as LC3 audio; see le_audio_mic.c.
 */

#include <math.h>

#include <zephyr/kernel.h>
#include <zephyr/device.h>
#include <zephyr/devicetree.h>
#include <zephyr/drivers/gpio.h>
#include <zephyr/drivers/i2c.h>
#include <zephyr/drivers/sensor.h>
#include <zephyr/input/input.h>
#include <zephyr/settings/settings.h>
#include <zephyr/sys/util.h>

#include <zephyr/bluetooth/bluetooth.h>
#include <zephyr/bluetooth/conn.h>
#include <zephyr/bluetooth/hci.h>
#include <zephyr/bluetooth/uuid.h>

#include <bluetooth/services/hids.h>

#include "le_audio_mic.h"

#include <zephyr/logging/log.h>
LOG_MODULE_REGISTER(air_mouse, LOG_LEVEL_INF);

#define IMU_NODE DT_ALIAS(imu0)

BUILD_ASSERT(DT_NODE_HAS_STATUS(IMU_NODE, okay),
	     "imu0 alias is not enabled - this build target has no IMU");

/* WHO_AM_I sits at the same address across the LSM6DS family */
#define IMU_REG_WHO_AM_I 0x0f

/* ------------------------------------------------------------------------- */
/* Motion tuning                                                             */
/* ------------------------------------------------------------------------- */

/* Gyro sampling period. Matches the 104 Hz ODR configured in prj.conf. */
#define SAMPLE_PERIOD_MS 10
/* One HID report per two samples: 50 Hz is comfortably below the negotiated
 * connection interval, so reports never pile up in the controller.
 */
#define SAMPLES_PER_REPORT 2

/* Cursor pixels per radian of rotation. Raise for a twitchier pointer. */
#define CURSOR_GAIN_PX_PER_RAD 900.0f
/* Rates below this are treated as zero, so gyro bias does not creep. */
#define GYRO_DEADZONE_RAD_S 0.04f
/* HID relative axes are 8-bit signed. */
#define CURSOR_DELTA_MAX 127

/*
 * Axis mapping, with the board held flat and the USB connector pointing away
 * from you: yaw (about Z) sweeps the cursor horizontally, pitch (about X)
 * sweeps it vertically. Flip a sign if your pointer runs the wrong way.
 */
#define GYRO_IDX_CURSOR_X 2
#define GYRO_IDX_CURSOR_Y 0
#define CURSOR_X_SIGN (-1.0f)
#define CURSOR_Y_SIGN (-1.0f)

/* ------------------------------------------------------------------------- */
/* HID                                                                       */
/* ------------------------------------------------------------------------- */

#define BASE_USB_HID_SPEC_VERSION 0x0101

/* Report layout: buttons, X, Y, wheel. */
#define INPUT_REP_MOUSE_LEN   4
#define INPUT_REP_MOUSE_INDEX 0
#define INPUT_REP_MOUSE_ID    1

#define MOUSE_BTN_LEFT BIT(0)

BT_HIDS_DEF(hids_obj, INPUT_REP_MOUSE_LEN);

static const struct bt_data ad[] = {
	BT_DATA_BYTES(BT_DATA_FLAGS, (BT_LE_AD_GENERAL | BT_LE_AD_NO_BREDR)),
	BT_DATA_BYTES(BT_DATA_GAP_APPEARANCE,
		      (CONFIG_BT_DEVICE_APPEARANCE >> 0) & 0xff,
		      (CONFIG_BT_DEVICE_APPEARANCE >> 8) & 0xff),
	BT_DATA_BYTES(BT_DATA_UUID16_ALL, BT_UUID_16_ENCODE(BT_UUID_HIDS_VAL),
					  BT_UUID_16_ENCODE(BT_UUID_ASCS_VAL),
					  BT_UUID_16_ENCODE(BT_UUID_MICS_VAL)),
	BT_DATA_BYTES(BT_DATA_SVC_DATA16, LE_AUDIO_MIC_ADV_SVC_DATA),
};

static const struct bt_data sd[] = {
	BT_DATA(BT_DATA_NAME_COMPLETE, CONFIG_BT_DEVICE_NAME,
		sizeof(CONFIG_BT_DEVICE_NAME) - 1),
};

static struct bt_conn *cur_conn;
static bool in_boot_mode;

/* Set from the input callback, consumed by the motion loop. */
static atomic_t button_state;

static const struct gpio_dt_spec led = GPIO_DT_SPEC_GET(DT_ALIAS(led0), gpios);

static void advertising_start(void)
{
	int err;

	err = bt_le_adv_start(BT_LE_ADV_CONN_FAST_1, ad, ARRAY_SIZE(ad), sd, ARRAY_SIZE(sd));
	if (err == -EALREADY) {
		return;
	}
	if (err) {
		LOG_ERR("Advertising failed to start (err %d)", err);
		return;
	}

	LOG_INF("Advertising as \"%s\"", CONFIG_BT_DEVICE_NAME);
}

static void connected(struct bt_conn *conn, uint8_t err)
{
	char addr[BT_ADDR_LE_STR_LEN];

	bt_addr_le_to_str(bt_conn_get_dst(conn), addr, sizeof(addr));

	if (err) {
		LOG_ERR("Failed to connect to %s (0x%02x)", addr, err);
		advertising_start();
		return;
	}

	LOG_INF("Connected to %s", addr);

	if (bt_hids_connected(&hids_obj, conn)) {
		LOG_ERR("Failed to notify HID service about connection");
		return;
	}

	cur_conn = bt_conn_ref(conn);
	in_boot_mode = false;
	gpio_pin_set_dt(&led, 1);
}

static void disconnected(struct bt_conn *conn, uint8_t reason)
{
	LOG_INF("Disconnected (reason 0x%02x)", reason);

	if (bt_hids_disconnected(&hids_obj, conn)) {
		LOG_ERR("Failed to notify HID service about disconnection");
	}

	if (cur_conn == conn) {
		bt_conn_unref(cur_conn);
		cur_conn = NULL;
	}

	gpio_pin_set_dt(&led, 0);
	advertising_start();
}

static void security_changed(struct bt_conn *conn, bt_security_t level, enum bt_security_err err)
{
	if (err) {
		LOG_ERR("Security failed: level %u err %d", level, err);
	} else {
		LOG_INF("Security level %u - ready to move the cursor", level);
	}
}

BT_CONN_CB_DEFINE(conn_callbacks) = {
	.connected = connected,
	.disconnected = disconnected,
	.security_changed = security_changed,
};

static void pairing_complete(struct bt_conn *conn, bool bonded)
{
	LOG_INF("Pairing complete (bonded: %s)", bonded ? "yes" : "no");
}

static void pairing_failed(struct bt_conn *conn, enum bt_security_err reason)
{
	LOG_WRN("Pairing failed (reason %d)", reason);
}

static struct bt_conn_auth_info_cb conn_auth_info_callbacks = {
	.pairing_complete = pairing_complete,
	.pairing_failed = pairing_failed,
};

static void hids_pm_evt_handler(enum bt_hids_pm_evt evt, struct bt_conn *conn)
{
	switch (evt) {
	case BT_HIDS_PM_EVT_BOOT_MODE_ENTERED:
		LOG_INF("Boot protocol mode entered");
		in_boot_mode = true;
		break;
	case BT_HIDS_PM_EVT_REPORT_MODE_ENTERED:
		LOG_INF("Report protocol mode entered");
		in_boot_mode = false;
		break;
	default:
		break;
	}
}

static int hid_init(void)
{
	struct bt_hids_init_param hids_init_param = {0};
	struct bt_hids_inp_rep *hids_inp_rep;

	static const uint8_t report_map[] = {
		0x05, 0x01,       /* Usage Page (Generic Desktop) */
		0x09, 0x02,       /* Usage (Mouse) */
		0xA1, 0x01,       /* Collection (Application) */
		0x85, INPUT_REP_MOUSE_ID, /* Report Id */
		0x09, 0x01,       /* Usage (Pointer) */
		0xA1, 0x00,       /* Collection (Physical) */

		0x05, 0x09,       /* Usage Page (Button) */
		0x19, 0x01,       /* Usage Minimum (1) */
		0x29, 0x03,       /* Usage Maximum (3) */
		0x15, 0x00,       /* Logical Minimum (0) */
		0x25, 0x01,       /* Logical Maximum (1) */
		0x75, 0x01,       /* Report Size (1) */
		0x95, 0x03,       /* Report Count (3) */
		0x81, 0x02,       /* Input (Data, Variable, Absolute) */
		0x75, 0x05,       /* Report Size (5) */
		0x95, 0x01,       /* Report Count (1) */
		0x81, 0x01,       /* Input (Constant) for padding */

		0x05, 0x01,       /* Usage Page (Generic Desktop) */
		0x09, 0x30,       /* Usage (X) */
		0x09, 0x31,       /* Usage (Y) */
		0x09, 0x38,       /* Usage (Wheel) */
		0x15, 0x81,       /* Logical Minimum (-127) */
		0x25, 0x7F,       /* Logical Maximum (127) */
		0x75, 0x08,       /* Report Size (8) */
		0x95, 0x03,       /* Report Count (3) */
		0x81, 0x06,       /* Input (Data, Variable, Relative) */

		0xC0,             /* End Collection (Physical) */
		0xC0,             /* End Collection (Application) */
	};

	hids_init_param.rep_map.data = report_map;
	hids_init_param.rep_map.size = sizeof(report_map);

	hids_init_param.info.bcd_hid = BASE_USB_HID_SPEC_VERSION;
	hids_init_param.info.b_country_code = 0x00;
	hids_init_param.info.flags = (BT_HIDS_REMOTE_WAKE | BT_HIDS_NORMALLY_CONNECTABLE);

	hids_inp_rep = &hids_init_param.inp_rep_group_init.reports[INPUT_REP_MOUSE_INDEX];
	hids_inp_rep->size = INPUT_REP_MOUSE_LEN;
	hids_inp_rep->id = INPUT_REP_MOUSE_ID;
	hids_init_param.inp_rep_group_init.cnt++;

	hids_init_param.is_mouse = true;
	hids_init_param.pm_evt_handler = hids_pm_evt_handler;

	return bt_hids_init(&hids_obj, &hids_init_param);
}

static int mouse_report_send(uint8_t buttons, int8_t x, int8_t y)
{
	uint8_t report[INPUT_REP_MOUSE_LEN];

	if (!cur_conn) {
		return -ENOTCONN;
	}

	if (in_boot_mode) {
		return bt_hids_boot_mouse_inp_rep_send(&hids_obj, cur_conn, &buttons, x, y, NULL);
	}

	report[0] = buttons;
	report[1] = (uint8_t)x;
	report[2] = (uint8_t)y;
	report[3] = 0; /* wheel */

	return bt_hids_inp_rep_send(&hids_obj, cur_conn, INPUT_REP_MOUSE_INDEX,
				    report, sizeof(report), NULL);
}

/* ------------------------------------------------------------------------- */
/* Input                                                                     */
/* ------------------------------------------------------------------------- */

static void button_cb(struct input_event *evt, void *user_data)
{
	if (evt->type != INPUT_EV_KEY || evt->code != INPUT_KEY_ENTER) {
		return;
	}

	if (evt->value) {
		atomic_or(&button_state, MOUSE_BTN_LEFT);
	} else {
		atomic_and(&button_state, ~MOUSE_BTN_LEFT);
	}
}

INPUT_CALLBACK_DEFINE(NULL, button_cb, NULL);

/* ------------------------------------------------------------------------- */
/* IMU                                                                       */
/* ------------------------------------------------------------------------- */

/*
 * The IMU and PDM share a power rail switched by P0.01 (pdm_imu_pwr). A soft
 * reset leaves P0 - which lives in the always-on domain - untouched, so the
 * sensor stays powered and probes fine; a pin reset or a power cycle drops the
 * rail and the LSM6DS3TR-C needs ~15 ms to boot before it answers on I2C.
 *
 * regulator-fixed cannot cover that gap on its own: with regulator-boot-on set,
 * regulator_common_init() takes the "already enabled" path and never applies
 * startup-delay-us. Hold the boot sequence here instead, after the rail is
 * switched on (priority 41/45) and before the sensor is probed (priority 90).
 */
#define IMU_POWER_ON_DELAY_MS 50
/* SYS_INIT needs a literal priority, so assert the ordering instead. */
#define IMU_POWER_SETTLE_INIT_PRIORITY 89

BUILD_ASSERT(IMU_POWER_SETTLE_INIT_PRIORITY < CONFIG_SENSOR_INIT_PRIORITY,
	     "The IMU rail must settle before the sensor driver probes it");

static int imu_power_settle(void)
{
	const struct device *const bus = DEVICE_DT_GET(DT_BUS(IMU_NODE));

	k_msleep(IMU_POWER_ON_DELAY_MS);

	/*
	 * A reset in the middle of an I2C transfer leaves the sensor holding SDA
	 * low, and every later transfer - including the driver's WHO_AM_I probe -
	 * then fails until the bus is clocked out. Recover before probing.
	 */
	if (device_is_ready(bus)) {
		(void)i2c_recover_bus(bus);
	}

	return 0;
}

SYS_INIT(imu_power_settle, POST_KERNEL, IMU_POWER_SETTLE_INIT_PRIORITY);

static void imu_print_info(const struct device *imu)
{
	const struct i2c_dt_spec bus = I2C_DT_SPEC_GET(IMU_NODE);
	uint8_t who_am_i;
	int err;

	LOG_INF("IMU device    : %s", imu->name);
	LOG_INF("Devicetree    : %s (compatible \"%s\")",
		DT_NODE_FULL_NAME(IMU_NODE), DT_PROP(IMU_NODE, compatible_IDX_0));
	LOG_INF("Bus           : %s, address 0x%02x, %d Hz",
	       bus.bus->name, bus.addr, DT_PROP(DT_BUS(IMU_NODE), clock_frequency));

	err = i2c_reg_read_byte_dt(&bus, IMU_REG_WHO_AM_I, &who_am_i);
	if (err) {
		LOG_ERR("WHO_AM_I      : read failed (%d)", err);
	} else {
		LOG_INF("WHO_AM_I      : 0x%02x", who_am_i);
	}

	LOG_INF("Accelerometer : +/-%dg, ODR setting %d",
		CONFIG_LSM6DSL_ACCEL_FS, CONFIG_LSM6DSL_ACCEL_ODR);
	LOG_INF("Gyroscope     : +/-%ddps, ODR setting %d",
		CONFIG_LSM6DSL_GYRO_FS, CONFIG_LSM6DSL_GYRO_ODR);
}

/* Returns the yaw/pitch rates in rad/s, deadzone already applied. */
static int imu_read_rates(const struct device *imu, float *rate_x, float *rate_y)
{
	struct sensor_value gyro[3];
	float rates[2];
	int err;

	err = sensor_sample_fetch(imu);
	if (err) {
		return err;
	}

	err = sensor_channel_get(imu, SENSOR_CHAN_GYRO_XYZ, gyro);
	if (err) {
		return err;
	}

	rates[0] = CURSOR_X_SIGN * (float)sensor_value_to_double(&gyro[GYRO_IDX_CURSOR_X]);
	rates[1] = CURSOR_Y_SIGN * (float)sensor_value_to_double(&gyro[GYRO_IDX_CURSOR_Y]);

	for (int i = 0; i < 2; i++) {
		if ((rates[i] < GYRO_DEADZONE_RAD_S) && (rates[i] > -GYRO_DEADZONE_RAD_S)) {
			rates[i] = 0.0f;
		}
	}

	*rate_x = rates[0];
	*rate_y = rates[1];

	return 0;
}

/*
 * Pops the whole-pixel part of an accumulator, clamped to the HID range, and
 * leaves the remainder behind so slow drags are not rounded away.
 */
static int8_t accum_take(float *accum)
{
	float whole = (*accum < 0.0f) ? ceilf(*accum) : floorf(*accum);
	int delta = CLAMP((int)whole, -CURSOR_DELTA_MAX, CURSOR_DELTA_MAX);

	*accum -= (float)delta;

	return (int8_t)delta;
}

int main(void)
{
	const struct device *const imu = DEVICE_DT_GET(IMU_NODE);
	const float dt = SAMPLE_PERIOD_MS / 1000.0f;
	bool imu_ok;
	float x_accum = 0.0f;
	float y_accum = 0.0f;
	uint8_t last_buttons = 0;
	unsigned int tick = 0;
	int err;

	LOG_INF("XIAO nRF54L15 Sense air mouse + LE Audio mic - %s", CONFIG_BOARD_TARGET);

	/* A dead IMU costs the pointer, but the microphone, MICS and HID still
	 * work, so carry on rather than bringing the whole device down.
	 */
	imu_ok = device_is_ready(imu);
	if (!imu_ok) {
		LOG_ERR("IMU %s is not ready - continuing without pointer motion", imu->name);
	}

	if (!gpio_is_ready_dt(&led)) {
		LOG_ERR("LED is not ready");
		return 0;
	}
	gpio_pin_configure_dt(&led, GPIO_OUTPUT_INACTIVE);

	if (imu_ok) {
		imu_print_info(imu);
	}

	err = hid_init();
	if (err) {
		LOG_ERR("HID service init failed (err %d)", err);
		return 0;
	}

	err = bt_conn_auth_info_cb_register(&conn_auth_info_callbacks);
	if (err) {
		LOG_ERR("Failed to register auth info callbacks (err %d)", err);
		return 0;
	}

	/* Starts the HF clock and the PDM peripheral; must precede bt_enable(). */
	err = le_audio_mic_init();
	if (err) {
		LOG_ERR("LE Audio microphone init failed (err %d)", err);
		return 0;
	}

	err = bt_enable(NULL);
	if (err) {
		LOG_ERR("Bluetooth init failed (err %d)", err);
		return 0;
	}

	/* ASCS is a dynamic GATT service, and with CONFIG_BT_SETTINGS those
	 * cannot be registered until the settings have been loaded.
	 */
	if (IS_ENABLED(CONFIG_SETTINGS)) {
		settings_load();
	}

	err = le_audio_mic_start();
	if (err) {
		LOG_ERR("LE Audio microphone start failed (err %d)", err);
		return 0;
	}

	advertising_start();

	while (1) {
		float rate_x;
		float rate_y;
		uint8_t buttons;

		k_sleep(K_MSEC(SAMPLE_PERIOD_MS));

		if (!imu_ok) {
			continue;
		}

		if (imu_read_rates(imu, &rate_x, &rate_y)) {
			continue;
		}

		x_accum += rate_x * dt * CURSOR_GAIN_PX_PER_RAD;
		y_accum += rate_y * dt * CURSOR_GAIN_PX_PER_RAD;

		if ((++tick % SAMPLES_PER_REPORT) != 0) {
			continue;
		}

		buttons = (uint8_t)atomic_get(&button_state);

		if (!cur_conn) {
			/* Nothing to report to; do not let the deltas run away. */
			x_accum = 0.0f;
			y_accum = 0.0f;
			continue;
		}

		int8_t x = accum_take(&x_accum);
		int8_t y = accum_take(&y_accum);

		if (!x && !y && (buttons == last_buttons)) {
			continue;
		}

		err = mouse_report_send(buttons, x, y);
		if (err) {
			/* Report was dropped - put the motion back for next time. */
			x_accum += (float)x;
			y_accum += (float)y;
			if (err != -ENOMEM && err != -EACCES) {
				LOG_WRN("Report send failed (err %d)", err);
			}
			continue;
		}

		last_buttons = buttons;
	}

	return 0;
}
```

## src/le_audio_mic.c
```c
/*
 * Copyright (c) 2021-2023 Nordic Semiconductor ASA
 *
 * SPDX-License-Identifier: Apache-2.0
 */

/*
 * LE Audio unicast server exposing the on-board PDM microphone as an audio
 * source: PDM -> LC3 (16 kHz, 7.5 ms frames, mono) -> ISO.
 *
 * Adapted from the bap_unicast_server_nrf54l15 sample. The XIAO nRF54L15 Sense
 * carries the PDM microphone on the same pins as the DK overlay used there
 * (P1.12 CLK, P1.13 DIN), and its devicetree already enables pdm20 as
 * "dmic_dev", so no overlay is needed.
 */

#include <errno.h>
#include <stddef.h>

#include <zephyr/kernel.h>
#include <zephyr/types.h>
#include <zephyr/audio/dmic.h>
#include <zephyr/drivers/clock_control/nrf_clock_control.h>
#include <zephyr/sys/byteorder.h>

#include <zephyr/bluetooth/bluetooth.h>
#include <zephyr/bluetooth/conn.h>
#include <zephyr/bluetooth/hci.h>
#include <zephyr/bluetooth/audio/audio.h>
#include <zephyr/bluetooth/audio/bap.h>
#include <zephyr/bluetooth/audio/micp.h>
#include <zephyr/bluetooth/audio/pacs.h>

#include <hal/nrf_clock.h>
#include <hal/nrf_pdm.h>

#include "sw_codec_lc3.h"
#include "le_audio_mic.h"

#include <zephyr/logging/log.h>
LOG_MODULE_REGISTER(le_audio_mic, LOG_LEVEL_INF);

/* ------------------------------------------------------------------------- */
/* Audio format                                                              */
/* ------------------------------------------------------------------------- */

#define SAMPLE_RATE_HZ	   16000
#define FRAME_DURATION_US  7500
#define SAMPLE_BIT_WIDTH   16
#define BYTES_PER_SAMPLE   sizeof(int16_t)
#define NUM_SAMPLES	   ((FRAME_DURATION_US * SAMPLE_RATE_HZ) / USEC_PER_SEC)

/* PDM gain, 0x00..0x50. The DK sample tunes this with buttons; the XIAO has a
 * single button and it is the mouse click, so pick a value at build time.
 */
#define PDM_MIC_GAIN NRF_PDM_GAIN_DEFAULT

/* Clear the MICS mute when a stream starts. Set to 0 to leave whatever mute
 * state the host asked for untouched.
 */
#define LE_AUDIO_MIC_UNMUTE_ON_START 1

/* Size of one 7.5 ms block (the driver works in 10 ms units, hence the 75%). */
#define BLOCK_SIZE(_sample_rate, _number_of_channels)                                              \
	((BYTES_PER_SAMPLE * (_sample_rate / 100) * _number_of_channels) * 75 / 100)

#define MAX_BLOCK_SIZE BLOCK_SIZE(SAMPLE_RATE_HZ, 2)
#define BLOCK_COUNT    8

/* Blocks the DMIC driver fills and the fetch thread frees. */
K_MEM_SLAB_DEFINE_STATIC(mem_slab, MAX_BLOCK_SIZE, BLOCK_COUNT, 8);

NET_BUF_POOL_FIXED_DEFINE(tx_pool, CONFIG_BT_ASCS_MAX_ASE_SRC_COUNT,
			  BT_ISO_SDU_BUF_SIZE(CONFIG_BT_ISO_TX_MTU),
			  CONFIG_BT_CONN_TX_USER_DATA_SIZE, NULL);

/* One credit per buffer that may be in flight towards the controller. */
#define TOTAL_BUF_NEEDED 4
static K_SEM_DEFINE(lc3_encoder_sem, 0U, TOTAL_BUF_NEEDED);

#define LC3_ENCODER_STACK_SIZE 8192
#define LC3_ENCODER_PRIORITY   5

static void dmic_fetch_thread(void *arg1, void *arg2, void *arg3);
K_THREAD_DEFINE(dmic_fetch, LC3_ENCODER_STACK_SIZE, dmic_fetch_thread, NULL, NULL, NULL,
		LC3_ENCODER_PRIORITY, 0, -1);

static const struct device *const dmic_dev = DEVICE_DT_GET(DT_NODELABEL(dmic_dev));
static int16_t send_pcm_data[NUM_SAMPLES];

/* ------------------------------------------------------------------------- */
/* BAP state                                                                 */
/* ------------------------------------------------------------------------- */

static const struct bt_audio_codec_cap lc3_codec_cap = BT_AUDIO_CODEC_CAP_LC3(
	BT_AUDIO_CODEC_CAP_FREQ_16KHZ, BT_AUDIO_CODEC_CAP_DURATION_7_5,
	BT_AUDIO_CODEC_CAP_CHAN_COUNT_SUPPORT(1), 30u, 120u, 1u, BT_AUDIO_CONTEXT_TYPE_ANY);

static struct audio_source {
	struct bt_bap_stream stream;
	uint16_t seq_num;
	uint16_t max_sdu;
} source_streams[CONFIG_BT_ASCS_MAX_ASE_SRC_COUNT];

static int configured_octets_per_frame;
static size_t configured_source_stream_count;

static const struct bt_bap_qos_cfg_pref qos_pref =
	BT_BAP_QOS_CFG_PREF(true, BT_GAP_LE_PHY_2M, 0x02, 10, 10000, 40000, 10000, 40000);

static struct bt_conn *audio_conn;

/* Set from the MICS callback, read by the capture thread. */
static atomic_t mic_muted;

static uint16_t get_and_incr_seq_num(const struct bt_bap_stream *stream)
{
	for (size_t i = 0U; i < configured_source_stream_count; i++) {
		if (stream == &source_streams[i].stream) {
			return source_streams[i].seq_num++;
		}
	}

	LOG_INF("Could not find endpoint from stream %p", (void *)stream);

	return 0;
}

static void print_codec_cfg(const struct bt_audio_codec_cfg *codec_cfg)
{
	int ret;

	if (codec_cfg->id != BT_HCI_CODING_FORMAT_LC3) {
		LOG_INF("codec_cfg 0x%02x (not LC3)", codec_cfg->id);
		return;
	}

	ret = bt_audio_codec_cfg_get_freq(codec_cfg);
	if (ret > 0) {
		LOG_INF("  Frequency: %d Hz", bt_audio_codec_cfg_freq_to_freq_hz(ret));
	}

	ret = bt_audio_codec_cfg_get_frame_dur(codec_cfg);
	if (ret > 0) {
		LOG_INF("  Frame duration: %d us",
			bt_audio_codec_cfg_frame_dur_to_frame_dur_us(ret));
	}

	LOG_INF("  Octets per frame: %d", bt_audio_codec_cfg_get_octets_per_frame(codec_cfg));
}

/* Encodes the most recent PCM block and pushes it onto every source stream. */
static void send_data(void)
{
	uint8_t lc3_encoded_buffer[CONFIG_BT_ISO_TX_MTU];
	uint16_t encoded_bytes_written;
	struct net_buf *buf;
	int ret;

	for (size_t i = 0; i < configured_source_stream_count; i++) {
		struct bt_bap_stream *stream = &source_streams[i].stream;

		buf = net_buf_alloc(&tx_pool, K_FOREVER);
		net_buf_reserve(buf, BT_ISO_CHAN_SEND_RESERVE);

		ret = sw_codec_lc3_enc_run(send_pcm_data, sizeof(send_pcm_data),
					   configured_octets_per_frame * 8 * 100 * 100 / 75, 0,
					   sizeof(lc3_encoded_buffer), lc3_encoded_buffer,
					   &encoded_bytes_written);
		if (ret) {
			LOG_ERR("LC3 encoder failed - wrong parameters?: %d", ret);
			net_buf_unref(buf);
			return;
		}

		net_buf_add_mem(buf, lc3_encoded_buffer, configured_octets_per_frame);

		ret = bt_bap_stream_send(stream, buf, get_and_incr_seq_num(stream));
		if (ret < 0) {
			LOG_WRN("Failed to send audio data on stream %p: %d", (void *)stream, ret);
			net_buf_unref(buf);
		}
	}
}

static struct bt_bap_stream *stream_alloc(void)
{
	for (size_t i = 0; i < ARRAY_SIZE(source_streams); i++) {
		if (!source_streams[i].stream.conn) {
			return &source_streams[i].stream;
		}
	}

	return NULL;
}

static int lc3_config(struct bt_conn *conn, const struct bt_bap_ep *ep, enum bt_audio_dir dir,
		      const struct bt_audio_codec_cfg *codec_cfg, struct bt_bap_stream **stream,
		      struct bt_bap_qos_cfg_pref *const pref, struct bt_bap_ascs_rsp *rsp)
{
	uint16_t pcm_bytes_req_enc;
	int ret;

	LOG_INF("ASE codec config: conn %p ep %p dir %u", (void *)conn, (void *)ep, dir);
	print_codec_cfg(codec_cfg);

	/* Microphone only - there is nothing to render a sink stream to. */
	if (dir != BT_AUDIO_DIR_SOURCE) {
		LOG_WRN("Rejecting sink stream, this device is a source only");
		*rsp = BT_BAP_ASCS_RSP(BT_BAP_ASCS_RSP_CODE_CONF_UNSUPPORTED,
				       BT_BAP_ASCS_REASON_NONE);

		return -ENOTSUP;
	}

	*stream = stream_alloc();
	if (*stream == NULL) {
		LOG_WRN("No streams available");
		*rsp = BT_BAP_ASCS_RSP(BT_BAP_ASCS_RSP_CODE_NO_MEM, BT_BAP_ASCS_REASON_NONE);

		return -ENOMEM;
	}

	configured_octets_per_frame = bt_audio_codec_cfg_get_octets_per_frame(codec_cfg);

	ret = sw_codec_lc3_enc_init(SAMPLE_RATE_HZ, SAMPLE_BIT_WIDTH, FRAME_DURATION_US,
				    configured_octets_per_frame * 8 * 100 * 100 / 75, 1,
				    &pcm_bytes_req_enc);
	if (ret) {
		LOG_ERR("sw_codec_lc3_enc_init failed (ret %d)", ret);
	} else {
		LOG_INF("LC3 encoder ready, %u PCM bytes per frame", pcm_bytes_req_enc);
	}

	configured_source_stream_count = 1;

	*pref = qos_pref;

	return 0;
}

static int lc3_reconfig(struct bt_bap_stream *stream, enum bt_audio_dir dir,
			const struct bt_audio_codec_cfg *codec_cfg,
			struct bt_bap_qos_cfg_pref *const pref, struct bt_bap_ascs_rsp *rsp)
{
	LOG_INF("ASE codec reconfig: stream %p", (void *)stream);

	*rsp = BT_BAP_ASCS_RSP(BT_BAP_ASCS_RSP_CODE_CONF_UNSUPPORTED, BT_BAP_ASCS_REASON_NONE);

	/* Only one QoS is supported, reject changes. */
	return -ENOEXEC;
}

static int lc3_qos(struct bt_bap_stream *stream, const struct bt_bap_qos_cfg *qos,
		   struct bt_bap_ascs_rsp *rsp)
{
	LOG_INF("QoS: interval %u framing 0x%02x phy 0x%02x sdu %u rtn %u latency %u pd %u",
		qos->interval, qos->framing, qos->phy, qos->sdu, qos->rtn, qos->latency, qos->pd);

	for (size_t i = 0U; i < configured_source_stream_count; i++) {
		if (stream == &source_streams[i].stream) {
			source_streams[i].max_sdu = qos->sdu;
			break;
		}
	}

	return 0;
}

static int lc3_enable(struct bt_bap_stream *stream, const uint8_t meta[], size_t meta_len,
		      struct bt_bap_ascs_rsp *rsp)
{
	LOG_INF("Enable: stream %p", (void *)stream);

	return 0;
}

static int lc3_start(struct bt_bap_stream *stream, struct bt_bap_ascs_rsp *rsp)
{
	LOG_INF("Start: stream %p", (void *)stream);

	for (size_t i = 0U; i < configured_source_stream_count; i++) {
		if (stream == &source_streams[i].stream) {
			source_streams[i].seq_num = 0U;
			break;
		}
	}

	return 0;
}

static bool data_func_cb(struct bt_data *data, void *user_data)
{
	struct bt_bap_ascs_rsp *rsp = (struct bt_bap_ascs_rsp *)user_data;

	if (!BT_AUDIO_METADATA_TYPE_IS_KNOWN(data->type)) {
		LOG_WRN("Invalid metadata type %u or length %u", data->type, data->data_len);
		*rsp = BT_BAP_ASCS_RSP(BT_BAP_ASCS_RSP_CODE_METADATA_REJECTED, data->type);

		return false;
	}

	return true;
}

static int lc3_metadata(struct bt_bap_stream *stream, const uint8_t meta[], size_t meta_len,
			struct bt_bap_ascs_rsp *rsp)
{
	return bt_audio_data_parse(meta, meta_len, data_func_cb, rsp);
}

static int lc3_disable(struct bt_bap_stream *stream, struct bt_bap_ascs_rsp *rsp)
{
	LOG_INF("Disable: stream %p", (void *)stream);

	return 0;
}

static int lc3_stop(struct bt_bap_stream *stream, struct bt_bap_ascs_rsp *rsp)
{
	LOG_INF("Stop: stream %p", (void *)stream);

	return 0;
}

static int lc3_release(struct bt_bap_stream *stream, struct bt_bap_ascs_rsp *rsp)
{
	LOG_INF("Release: stream %p", (void *)stream);

	return 0;
}

static struct bt_bap_unicast_server_register_param unicast_server_param = {
	CONFIG_BT_ASCS_MAX_ASE_SNK_COUNT, CONFIG_BT_ASCS_MAX_ASE_SRC_COUNT};

static const struct bt_bap_unicast_server_cb unicast_server_cb = {
	.config = lc3_config,
	.reconfig = lc3_reconfig,
	.qos = lc3_qos,
	.enable = lc3_enable,
	.start = lc3_start,
	.metadata = lc3_metadata,
	.disable = lc3_disable,
	.stop = lc3_stop,
	.release = lc3_release,
};

/* ------------------------------------------------------------------------- */
/* Stream callbacks                                                          */
/* ------------------------------------------------------------------------- */

static void disconnect_work_handler(struct k_work *work)
{
	if (audio_conn) {
		bt_conn_disconnect(audio_conn, BT_HCI_ERR_REMOTE_USER_TERM_CONN);
	}
}

K_WORK_DEFINE(work_disconnect, disconnect_work_handler);

static void stream_started(struct bt_bap_stream *stream)
{
	int ret;

	LOG_INF("Audio stream %p started", (void *)stream);

	if (LE_AUDIO_MIC_UNMUTE_ON_START) {
		/*
		 * Some hosts leave MICS muted by default, which would make the
		 * stream carry nothing but silence with no obvious cause. Clear
		 * the mute as the stream starts. This is a local write, so it is
		 * accepted even when remote mute changes are disabled, and the
		 * client is notified of the resulting state.
		 */
		ret = bt_micp_mic_dev_unmute();
		if (ret) {
			LOG_WRN("Failed to unmute microphone (err %d)", ret);
		}
	}

	k_thread_resume(dmic_fetch);

	ret = dmic_trigger(dmic_dev, DMIC_TRIGGER_START);
	if (ret < 0) {
		LOG_ERR("DMIC start trigger failed: %d", ret);
	} else {
		LOG_INF("Microphone streaming");
		k_sem_give(&lc3_encoder_sem);
	}
}

static void stream_stopped(struct bt_bap_stream *stream, uint8_t reason)
{
	int ret;

	LOG_INF("Audio stream %p stopped, reason 0x%02x", (void *)stream, reason);

	k_thread_suspend(dmic_fetch);

	ret = dmic_trigger(dmic_dev, DMIC_TRIGGER_STOP);
	if (ret < 0) {
		LOG_ERR("DMIC stop trigger failed: %d", ret);
	}

	sw_codec_lc3_enc_uninit_all();

	/* If the ISO link timed out, drop the ACL so the client re-establishes
	 * both the connection and the stream.
	 */
	if (reason == BT_HCI_ERR_CONN_TIMEOUT) {
		k_work_submit(&work_disconnect);
	}
}

static void stream_sent_cb(struct bt_bap_stream *stream)
{
	k_sem_give(&lc3_encoder_sem);
}

static struct bt_bap_stream_ops stream_ops = {
	.started = stream_started,
	.stopped = stream_stopped,
	.sent = stream_sent_cb,
};

/* ------------------------------------------------------------------------- */
/* Connection tracking                                                       */
/* ------------------------------------------------------------------------- */

static void audio_connected(struct bt_conn *conn, uint8_t err)
{
	if (err) {
		return;
	}

	audio_conn = bt_conn_ref(conn);
}

static void audio_disconnected(struct bt_conn *conn, uint8_t reason)
{
	if (conn != audio_conn) {
		return;
	}

	bt_conn_unref(audio_conn);
	audio_conn = NULL;
	configured_source_stream_count = 0U;
}

static void audio_security_changed(struct bt_conn *conn, bt_security_t level,
				   enum bt_security_err err)
{
	/* A stale bond on either side leaves the client unable to read ASCS;
	 * drop the bond so the next attempt pairs cleanly.
	 */
	if (err == BT_SECURITY_ERR_AUTH_REQUIREMENT) {
		LOG_WRN("Authentication requirement failed, unpairing");
		bt_unpair(BT_ID_DEFAULT, bt_conn_get_dst(conn));
		bt_conn_disconnect(conn, BT_HCI_ERR_AUTH_FAIL);
	}
}

BT_CONN_CB_DEFINE(audio_conn_callbacks) = {
	.connected = audio_connected,
	.disconnected = audio_disconnected,
	.security_changed = audio_security_changed,
};

/* ------------------------------------------------------------------------- */
/* PACS                                                                      */
/* ------------------------------------------------------------------------- */

static struct bt_pacs_cap cap_source = {
	.codec_cap = &lc3_codec_cap,
};

static int pacs_configure(void)
{
	int err;

	if (IS_ENABLED(CONFIG_BT_PAC_SRC_LOC)) {
		err = bt_pacs_set_location(BT_AUDIO_DIR_SOURCE, BT_AUDIO_LOCATION_FRONT_LEFT);
		if (err) {
			LOG_ERR("Failed to set source location (err %d)", err);
			return err;
		}
	}

	if (IS_ENABLED(CONFIG_BT_PAC_SRC)) {
		err = bt_pacs_set_supported_contexts(BT_AUDIO_DIR_SOURCE,
						     LE_AUDIO_MIC_SOURCE_CONTEXT);
		if (err) {
			LOG_ERR("Failed to set source supported contexts (err %d)", err);
			return err;
		}

		err = bt_pacs_set_available_contexts(BT_AUDIO_DIR_SOURCE,
						     LE_AUDIO_MIC_SOURCE_CONTEXT);
		if (err) {
			LOG_ERR("Failed to set source available contexts (err %d)", err);
			return err;
		}
	}

	return 0;
}

/* ------------------------------------------------------------------------- */
/* Microphone Control Service                                                */
/* ------------------------------------------------------------------------- */

static void mic_dev_mute_cb(uint8_t mute)
{
	switch (mute) {
	case BT_MICP_MUTE_MUTED:
		atomic_set(&mic_muted, 1);
		LOG_INF("Microphone muted");
		break;
	case BT_MICP_MUTE_UNMUTED:
		atomic_set(&mic_muted, 0);
		LOG_INF("Microphone unmuted");
		break;
	case BT_MICP_MUTE_DISABLED:
		/* Mute cannot be changed remotely; keep capturing. */
		atomic_set(&mic_muted, 0);
		LOG_INF("Microphone mute disabled");
		break;
	default:
		LOG_WRN("Unknown mute state %u", mute);
		break;
	}
}

static struct bt_micp_mic_dev_cb mic_dev_cb = {
	.mute = mic_dev_mute_cb,
};

/* ------------------------------------------------------------------------- */
/* PDM microphone                                                            */
/* ------------------------------------------------------------------------- */

static void dmic_fetch_thread(void *arg1, void *arg2, void *arg3)
{
	void *buffer;
	uint32_t size;
	int ret;

	while (true) {
		k_sem_take(&lc3_encoder_sem, K_FOREVER);

		ret = dmic_read(dmic_dev, 0, &buffer, &size, 10);
		if (ret < 0) {
			LOG_ERR("DMIC read failed: %d", ret);
			continue;
		}

		if (size > sizeof(send_pcm_data)) {
			LOG_WRN("DMIC block %u larger than %zu, truncating", size,
				sizeof(send_pcm_data));
			size = sizeof(send_pcm_data);
		}

		memcpy(send_pcm_data, buffer, size);
		k_mem_slab_free(&mem_slab, buffer);

		/* Transmit silence rather than stopping: the stream keeps its
		 * ISO timing and TX credits, so unmuting is seamless.
		 */
		if (atomic_get(&mic_muted)) {
			memset(send_pcm_data, 0, sizeof(send_pcm_data));
		}

		send_data();
	}
}

static int pdm_mic_init(void)
{
	struct pcm_stream_cfg stream = {
		.pcm_width = SAMPLE_BIT_WIDTH,
		.mem_slab = &mem_slab,
	};
	struct dmic_cfg cfg = {
		.io = {
			/* Bounds the PDM clock to what the microphone supports. */
			.min_pdm_clk_freq = 1000000,
			.max_pdm_clk_freq = 3250000,
			.min_pdm_clk_dc = 40,
			.max_pdm_clk_dc = 60,
		},
		.streams = &stream,
		.channel = {
			.req_num_streams = 1,
		},
	};
	int err;

	if (!device_is_ready(dmic_dev)) {
		LOG_ERR("DMIC device %s is not ready", dmic_dev->name);
		return -ENODEV;
	}

	cfg.channel.req_num_chan = 1;
	cfg.channel.req_chan_map_lo = dmic_build_channel_map(0, 0, PDM_CHAN_LEFT);
	cfg.streams[0].pcm_rate = SAMPLE_RATE_HZ;
	cfg.streams[0].block_size = BLOCK_SIZE(cfg.streams[0].pcm_rate, cfg.channel.req_num_chan);

	err = dmic_configure(dmic_dev, &cfg);
	if (err < 0) {
		LOG_ERR("Failed to configure the DMIC driver: %d", err);
		return err;
	}

	nrf_pdm_gain_set(NRF_PDM20_S, PDM_MIC_GAIN, PDM_MIC_GAIN);

	LOG_INF("PDM microphone ready: %d Hz mono, %d us frames, %u byte blocks", SAMPLE_RATE_HZ,
		FRAME_DURATION_US, cfg.streams[0].block_size);

	return 0;
}

/* The PDM peripheral and the LC3 codec both need the HF clock running. */
static int clocks_start(void)
{
	struct onoff_manager *clk_mgr;
	struct onoff_client clk_cli;
	int err;
	int res;

	clk_mgr = z_nrf_clock_control_get_onoff(CLOCK_CONTROL_NRF_SUBSYS_HF);
	if (!clk_mgr) {
		LOG_ERR("Unable to get the clock manager");
		return -ENXIO;
	}

	sys_notify_init_spinwait(&clk_cli.notify);

	err = onoff_request(clk_mgr, &clk_cli);
	if (err < 0) {
		LOG_ERR("Clock request failed: %d", err);
		return err;
	}

	do {
		err = sys_notify_fetch_result(&clk_cli.notify, &res);
		if (!err && res) {
			LOG_ERR("Clock could not be started: %d", res);
			return res;
		}
	} while (err);

#if defined(NRF54L15_XXAA)
	/* MLTPAN-20 */
	nrf_clock_task_trigger(NRF_CLOCK, NRF_CLOCK_TASK_PLLSTART);
#endif

	return 0;
}

/* ------------------------------------------------------------------------- */
/* Public API                                                                */
/* ------------------------------------------------------------------------- */

int le_audio_mic_init(void)
{
	int err;

	err = clocks_start();
	if (err) {
		LOG_ERR("Failed to start clocks (err %d)", err);
		return err;
	}

	err = pdm_mic_init();
	if (err) {
		LOG_ERR("Cannot init PDM mic (err %d)", err);
		return err;
	}

	return 0;
}

int le_audio_mic_start(void)
{
	/* Since NCS v3.1 PACS must be registered before any capability is added. */
	const struct bt_pacs_register_param pacs_param = {
		.src_pac = true,
		.src_loc = true,
	};
	struct bt_micp_mic_dev_register_param mic_dev_param = {
		.cb = &mic_dev_cb,
	};
	int err;

	err = bt_pacs_register(&pacs_param);
	if (err) {
		LOG_ERR("Failed to register PACS (err %d)", err);
		return err;
	}

	err = sw_codec_lc3_init(NULL, NULL, FRAME_DURATION_US);
	if (err) {
		LOG_ERR("sw_codec_lc3_init failed (err %d)", err);
		return err;
	}

	err = bt_bap_unicast_server_register(&unicast_server_param);
	if (err) {
		LOG_ERR("Failed to register unicast server (err %d)", err);
		return err;
	}

	err = bt_bap_unicast_server_register_cb(&unicast_server_cb);
	if (err) {
		LOG_ERR("Failed to register unicast server callbacks (err %d)", err);
		return err;
	}

	err = bt_pacs_cap_register(BT_AUDIO_DIR_SOURCE, &cap_source);
	if (err) {
		LOG_ERR("Failed to register source capability (err %d)", err);
		return err;
	}

	/* MICS is a dynamic GATT service too, so this must also run after
	 * settings_load(). It lets the client mute the microphone.
	 */
	err = bt_micp_mic_dev_register(&mic_dev_param);
	if (err) {
		LOG_ERR("Failed to register MICS (err %d)", err);
		return err;
	}

	for (size_t i = 0; i < ARRAY_SIZE(source_streams); i++) {
		bt_bap_stream_cb_register(&source_streams[i].stream, &stream_ops);
	}

	err = pacs_configure();
	if (err) {
		return err;
	}

	k_thread_start(dmic_fetch);

	LOG_INF("LE Audio microphone ready (MICS mute available)");

	return 0;
}
```

## src/le_audio_mic.h
```c
/*
 * Copyright (c) 2021-2023 Nordic Semiconductor ASA
 *
 * SPDX-License-Identifier: Apache-2.0
 */

#ifndef LE_AUDIO_MIC_H_
#define LE_AUDIO_MIC_H_

#include <zephyr/bluetooth/audio/audio.h>
#include <zephyr/bluetooth/byteorder.h>
#include <zephyr/bluetooth/uuid.h>

/*
 * The board has a microphone and no speaker, so it is a source only. An
 * available sink context of 0x0000 tells the client there is nothing to render
 * to, which keeps hosts (Windows in particular) from creating an output
 * endpoint for the device.
 */
#define LE_AUDIO_MIC_SINK_CONTEXT   0x0000
#define LE_AUDIO_MIC_SOURCE_CONTEXT BT_AUDIO_CONTEXT_TYPE_ANY

/*
 * BAP unicast announcement, for use inside BT_DATA_BYTES(BT_DATA_SVC_DATA16, ...).
 * This is what makes a unicast client recognise the device as an audio endpoint.
 */
#define LE_AUDIO_MIC_ADV_SVC_DATA                                                                  \
	BT_UUID_16_ENCODE(BT_UUID_ASCS_VAL),                                                       \
	BT_AUDIO_UNICAST_ANNOUNCEMENT_TARGETED,                                                    \
	BT_BYTES_LIST_LE16(LE_AUDIO_MIC_SINK_CONTEXT),                                             \
	BT_BYTES_LIST_LE16(LE_AUDIO_MIC_SOURCE_CONTEXT),                                           \
	0x00 /* Metadata length */

/**
 * @brief Start the HF clock and bring up the PDM microphone.
 *
 * Must be called before bt_enable().
 */
int le_audio_mic_init(void);

/**
 * @brief Register the unicast server, PACS capabilities and audio streams.
 *
 * Must be called after bt_enable().
 */
int le_audio_mic_start(void);

#endif /* LE_AUDIO_MIC_H_ */
```
